## zephyr/Kconfig
```kconfig
# SPDX-License-Identifier: MIT

config KRITIS3M_ASL
	bool "Enable KRITIS3M Abstract Security Library"
	depends on WOLFSSL
	help
	  This option enables the KRITIS3M Abstract Security Library as a Zephyr module.

menu "KRITIS3M ASL configuration"

config KRITIS3M_ASL_PKCS11
	bool "Enable PKCS#11 support"
	depends on KRITIS3M_ASL
	help
	  This option enables PKCS#11 support in the KRITIS3M Abstract Security Library.

config KRITIS3M_ASL_INTERNAL_API
	bool "Enable access to WolfSSL internal API"
	depends on KRITIS3M_ASL
	help
	  This option enables access to the internal WolfSSL API in the KRITIS3M Abstract Security Library.

config KRITIS3M_ASL_HEAP_TRACKING
	bool "Enable heap memory tracking"
	depends on KRITIS3M_ASL
	help
	  This option enables log messages to track the allocated heap memory of specific methods during runtine.

config KRITIS3M_ASL_CONSTANT_PRNG
	bool "Enable constant PRNG for testing (!!! INSECURE !!!)"
	depends on KRITIS3M_ASL
	help
	  This option enables a constant Pseudo-Random Number Generator (PRNG) for testing purposes.

endmenu
```
